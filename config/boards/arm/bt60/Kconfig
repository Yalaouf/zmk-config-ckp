## config/boards/arm/bt60/Kconfig
```kconfig
# SPDX-License-Identifier: MIT

config BOARD_ENABLE_DCDC
	bool "Enable DCDC mode"
	select SOC_DCDC_NRF52X
	default y
	depends on BOARD_BT60

CONFIG_ZMK_IDLE_TIMEOUT=10000
CONFIG_ZMK_SLEEP=y
CONFIG_ZMK_IDLE_SLEEP_TIMEOUT=900000s
CONFIG_ZMK_KEYBOARD_NAME=youssof-keyboard
#CONFIG_ZMK_USB_LOGGING=y
```

## config/boards/arm/bt60/Kconfig.board
```kconfig
# BT60 board configuration

# Copyright (c) 2021 Polarity Works
# SPDX-License-Identifier: MIT

config BOARD_BT60
	bool "bt60"
	depends on SOC_NRF52840_QIAA

CONFIG_ZMK_IDLE_TIMEOUT=10000
CONFIG_ZMK_SLEEP=y
CONFIG_ZMK_IDLE_SLEEP_TIMEOUT=900000s
CONFIG_ZMK_KEYBOARD_NAME=youssof-keyboard
#CONFIG_ZMK_USB_LOGGING=y
```
